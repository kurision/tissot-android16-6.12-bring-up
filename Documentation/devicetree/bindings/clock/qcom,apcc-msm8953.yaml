## Documentation/devicetree/bindings/regulator/qcom,mem-acc-regulator.yaml
```yaml
# SPDX-License-Identifier: (GPL-2.0 OR BSD-2-Clause)
%YAML 1.2
---
$id: http://devicetree.org/schemas/regulator/qcom,mem-acc-regulator.yaml#
$schema: http://devicetree.org/meta-schemas/core.yaml#

title: Qualcomm memory-ACC regulator

maintainers:
  - Andy Gross <agross@kernel.org>

description: >
  A memory-ACC regulator is a two-value corner selector: it does not produce a
  voltage, it switches one or two hardware register bits that select which
  memory array setting a corner uses. The values it exports are corner numbers,
  not microvolts, and the register bits it drives are named in the node.

allOf:
  - $ref: regulator.yaml#

properties:
  compatible:
    const: qcom,mem-acc-regulator

  reg:
    items:
      - description: Selector register for memory array level 1
      - description: Selector register for memory array level 2
    minItems: 2
    maxItems: 2

  reg-names:
    items:
      - const: acc-sel-l1
      - const: acc-sel-l2

  qcom,corner-acc-map:
    $ref: /schemas/types.yaml#/definitions/uint32-array
    description:
      Selector values for the two corners, in corner order. Exactly two
      entries.

  qcom,acc-sel-l1-bit-pos:
    $ref: /schemas/types.yaml#/definitions/uint32
    description: Bit position of the level 1 selector within its register.

  qcom,acc-sel-l2-bit-pos:
    $ref: /schemas/types.yaml#/definitions/uint32
    description: Bit position of the level 2 selector within its register.

  qcom,acc-sel-l1-bit-size:
    $ref: /schemas/types.yaml#/definitions/uint32
    description: Bit width of the level 1 selector.

  qcom,acc-sel-l2-bit-size:
    $ref: /schemas/types.yaml#/definitions/uint32
    description: Bit width of the level 2 selector.

required:
  - compatible
  - reg
  - reg-names
  - qcom,corner-acc-map
  - qcom,acc-sel-l1-bit-pos
  - qcom,acc-sel-l2-bit-pos
  - qcom,acc-sel-l1-bit-size
  - qcom,acc-sel-l2-bit-size

examples:
  - |
    apc_mem_acc_vreg: regulator@19461d4 {
        compatible = "qcom,mem-acc-regulator";
        reg = <0x019461d4 0x4>, <0x019461d8 0x4>;
        reg-names = "acc-sel-l1", "acc-sel-l2";
        regulator-name = "apc_mem_acc_corner";
        regulator-min-microvolt = <1>;
        regulator-max-microvolt = <2>;

        qcom,corner-acc-map = <0x1 0x0>;
        qcom,acc-sel-l1-bit-pos = <0>;
        qcom,acc-sel-l1-bit-size = <1>;
        qcom,acc-sel-l2-bit-pos = <0>;
        qcom,acc-sel-l2-bit-size = <1>;
    };
...
```

## Documentation/devicetree/bindings/regulator/qcom,spm-regulator.yaml
```yaml
# SPDX-License-Identifier: (GPL-2.0-only OR BSD-2-Clause)
%YAML 1.2
---
$id: http://devicetree.org/schemas/regulator/qcom,spm-regulator.yaml#
$schema: http://devicetree.org/meta-schemas/core.yaml#

title: Qualcomm SPM-backed SPMI PMIC SMPS regulator

maintainers:
  - Unmaintained

description: |
  Some Qualcomm SPMI PMIC SMPS regulators (for example the PM8953 S5/S6
  VDD_APC supply) are driven through the shared sub-system power manager
  (SPM/SAW) instead of writing the PMIC voltage set point over SPMI directly.
  The SPM owns the PMIC voltage data so that hardware AVS and power-collapse
  entry use the programmed level. An optional child node exposes the AVS
  minimum/maximum limit regulator that a CPR controller programs.

allOf:
  - $ref: regulator.yaml#

properties:
  compatible:
    const: qcom,spm-regulator

  reg:
    maxItems: 1

  qcom,saw:
    $ref: /schemas/types.yaml#/definitions/phandle
    description:
      Phandle to the SAW/SPM voltage controller that drives this rail.

  qcom,bypass-spm:
    type: boolean
    description:
      Drive the SMPS through SPMI only and do not use the SPM.

  qcom,mode:
    enum: [auto, pwm]
    description: Initial SMPS mode.

  qcom,max-voltage-step:
    $ref: /schemas/types.yaml#/definitions/uint32
    description:
      Largest voltage change applied in a single step, in microvolts.

patternProperties:
  "^avs-limit-regulator$":
    type: object
    $ref: regulator.yaml#
    unevaluatedProperties: false

required:
  - compatible
  - reg
  - regulator-name

unevaluatedProperties: false

examples:
  - |
    #include <dt-bindings/spmi/spmi.h>

    spmi {
        #address-cells = <1>;
        #size-cells = <0>;

        pmic@1 {
            compatible = "qcom,pm8953", "qcom,spmi-pmic";
            reg = <1 SPMI_USID>;
            #address-cells = <1>;
            #size-cells = <0>;

            regulator@2000 {
                compatible = "qcom,spm-regulator";
                reg = <0x2000 0x100>;
                regulator-name = "pm8953_s5";
                regulator-min-microvolt = <400000>;
                regulator-max-microvolt = <1140000>;

                avs-limit-regulator {
                    regulator-name = "pm8953_s5_avs_limit";
                    regulator-min-microvolt = <400000>;
                    regulator-max-microvolt = <1140000>;
                };
            };
        };
    };
...
```

## Documentation/devicetree/bindings/soc/qcom/qcom,msm8953-apm.yaml
```yaml
# SPDX-License-Identifier: (GPL-2.0 OR BSD-2-Clause)
%YAML 1.2
---
$id: http://devicetree.org/schemas/soc/qcom/qcom,msm8953-apm.yaml#
$schema: http://devicetree.org/meta-schemas/core.yaml#

title: Qualcomm MSM8953 Application Power Mux (APM)

maintainers:
  - Andy Gross <agross@kernel.org>

description: >
  The application power mux switches the CPU memory arrays between the APCC
  supply and the MX supply. A voltage controller coordinates the switch with
  the memory-ACC selector and the ring oscillators, and needs to know how long
  the selection takes to settle.

properties:
  compatible:
    const: qcom,msm8953-apm

  reg:
    maxItems: 1

  reg-names:
    items:
      - const: pm-apcc-glb
    minItems: 1
    maxItems: 1

  qcom,apm-sel-switch-delay:
    $ref: /schemas/types.yaml#/definitions/uint32
    description: Delay, in unspecified units, after the supply select switch.

  qcom,apm-resume-clk-delay:
    $ref: /schemas/types.yaml#/definitions/uint32
    description: Delay, in unspecified units, after the memory array clock resumes.

  qcom,apm-halt-clk-delay:
    $ref: /schemas/types.yaml#/definitions/uint32
    description: Delay, in unspecified units, after the memory array clock halts.

  qcom,apm-post-halt-delay:
    $ref: /schemas/types.yaml#/definitions/uint32
    description: Delay, in unspecified units, after the memory array halts.

required:
  - compatible
  - reg
  - reg-names

additionalProperties: false

examples:
  - |
    apc_apm: apm@b111000 {
        compatible = "qcom,msm8953-apm";
        reg = <0xb111000 0x1000>;
        reg-names = "pm-apcc-glb";
        qcom,apm-post-halt-delay = <0x2>;
        qcom,apm-halt-clk-delay = <0x11>;
        qcom,apm-resume-clk-delay = <0x10>;
        qcom,apm-sel-switch-delay = <0x01>;
    };
...
```

## drivers/char/diag/Kconfig
```kconfig
# SPDX-License-Identifier: GPL-2.0-only
menu "Diag Support"

config DIAG_CHAR
	tristate "DIAG CHAR Interface Core"
	default n
	depends on USB_CONFIGFS_F_DIAG || USB_FUNCTION_DIAG || USB_QCOM_MAEMO
	depends on ARCH_QCOM
	select CRC_CCITT
	help
	  Char driver interface for SoC Diagnostic information. The DIAG Char
	  driver provides diag forwarding to user space and SoC Peripherals.
	  This enables diagchar for maemo usb gadget or android usb gadget
	  based on config selected.

	  The donor 4.19 tree also gated this on POWER_RESET_QCOM, which set
	  the download-mode restart reason from the DIAG DLOAD command. This
	  tree has no such restart driver; diag_compat.h stubs
	  msm_set_restart_mode(), so the dependency is dropped here.

config DIAG_OVER_USB
	bool "Enable DIAG traffic to go over USB"
	depends on DIAG_CHAR
	depends on ARCH_QCOM
	default y
	help
	  Diag over USB enables sending DIAG traffic over a USB transport. When
	  the USB endpoints become available, the DIAG driver will enable Diag
	  traffic over USB. This allows for host side tools to parse and display
	  Diag traffic from the USB endpoint.

endmenu
```

## drivers/input/fingerprint/Kconfig
```kconfig
# SPDX-License-Identifier: GPL-2.0-only
#
# Fingerprint sensor device configuration
#

config FINGERPRINT_FPC1020
	tristate "FingerPrint Cards fingerprint driver support"
	help
	  Say Y here to enable support for the FPC1020 fingerprint
	  sensor platform driver. It exports the sysfs interface
	  (/sys/devices/soc/soc:fpc1020) the vendor fingerprint HAL
	  uses alongside the fpctzapp trustlet.

config FINGERPRINT_GOODIX_GF3208
	tristate "Goodix GF3208 fingerprint driver support"
	help
	  Say Y here to enable support for the Goodix GF3208
	  fingerprint sensor driver. It exposes /dev/goodix_fp with
	  ioctls and a netlink channel for the vendor GF HAL, which
	  runs the matching algorithm in the goodixfp trustlet.
```

## drivers/media/platform/msm/Kconfig
```kconfig
# SPDX-License-Identifier: GPL-2.0-only

comment "Qualcomm MSM media platform drivers"

source "drivers/media/platform/msm/vidc_3x/Kconfig"
source "drivers/media/platform/msm/camera/Kconfig"
```

## drivers/media/platform/msm/camera/Kconfig
```kconfig
# SPDX-License-Identifier: GPL-2.0-only
#
# The CAF camera stack (the donor's techpack/camera-legacy).
#
# The donor had two camera stacks for the same SoC generation and chose
# between them per board (the "legacy" one and the "legacy-n" one); this
# tree has only the legacy one, so the symbols of the donor's
# Kconfig.orig that are still used by the Makefiles are kept and the
# rest are not.

menu "Qualcomm MSM camera (legacy)"

config MSMB_CAMERA
	bool

config MSMB_CAMERA_LEGACY
	bool "Qualcomm MSM camera and video capture 2.0 support (legacy)"
	select MSMB_CAMERA
	help
	  Say Y here to enable the camera driver stack of the donor's
	  techpack/camera-legacy: the sensor framework with the CCI, the
	  CSIPHY and the CSID, the ISPIF, the VFE, the CPP and the JPEG
	  encoder. The ROM's mm-qcamera-daemon drives this interface.

config MSM_CAMERA_VFE
	bool "QTI MSM camera VFE, ISPIF and CSID support"
	depends on MSMB_CAMERA
	help
	  The pixel processor, the interface between the CSID and the VFE,
	  and the CSI receivers.  This is the part of the stack that turns
	  the sensor's frames into images, and it needs the pm8953's GDSC
	  rails, which this tree does not describe yet.

config MSM_CAMERA_CPP
	bool "QTI MSM camera post processing engine support"
	depends on MSMB_CAMERA
	help
	  The post processing engine: the scaling and the cropping of the
	  image, and the JPEG encoder's input.  It needs the pm8953's GDSC
	  rails, which this tree does not describe yet.

config MSM_CAMERA_SENSOR
	bool "QTI MSM camera sensor support"
	depends on MSMB_CAMERA
	select NEW_LEDS
	select LEDS_CLASS
	help
	  This flag enables support for the camera sensor. The sensor
	  driver is capable of providing real time data for camera
	  support. The driver supports the V4L2 subdev API.

config MSM_CPP
	bool "QTI MSM camera post processing engine support"
	depends on MSMB_CAMERA
	help
	  Enable support for the camera post-processing engine. The post
	  processing engine is capable of scaling and cropping the image.
	  The driver supports the V4L2 subdev API.

config MSM_CCI
	bool "QTI MSM camera control interface support"
	depends on MSMB_CAMERA
	help
	  Enable support for the camera control interface driver only for
	  those platforms that have hardware support. This driver is
	  responsible for handling the I2C read and write on the I2C bus.
	  It is also responsible for the synchronization with the GPIO and
	  the data frames.

config MSM_CSIPHY
	bool "QTI MSM camera CSIPHY support"
	depends on MSMB_CAMERA
	help
	  Enable support for the camera CSIPHY (the camera serial interface
	  physical layer).

config MSM_CSID
	bool "QTI MSM camera CSID support"
	depends on MSMB_CAMERA
	help
	  Enable support for the camera CSID (the camera serial interface
	  digital).

config MSM_EEPROM
	bool "QTI MSM camera EEPROM support"
	depends on MSMB_CAMERA
	help
	  Enable support for the camera EEPROM, which carries the module
	  calibration of the camera.

config MSM_ISPIF_V2
	bool "QTI MSM image signal processing interface support"
	depends on MSMB_CAMERA
	help
	  Enable support for the image signal processing interface module.
	  This module acts as a crossbar between the CSID and the VFE: the
	  output of any CID of the CSID can be routed to the pixel or the
	  raw data interface of the VFE.

config MSMB_JPEG
	bool "QTI MSM JPEG encoder engine support"
	depends on MSMB_CAMERA
	help
	  Enable support for the JPEG encoder engine.

config MSM_FD
	bool "QTI MSM face detection engine support"
	depends on MSMB_CAMERA
	depends on MSM_CAMERA_CPP
	help
	  Enable support for the MSM face detection engine.  The engine runs
	  on the post processing engine's hardware, so it follows that
	  symbol: with the CPP out of the build, this one cannot be linked
	  either.

config MSM_JPEGDMA
	bool "QTI MSM JPEG DMA engine support"
	depends on MSMB_CAMERA
	help
	  Enable support for the MSM JPEG DMA engine.

endmenu
```

## sound/soc/msm/Kconfig
```kconfig
# SPDX-License-Identifier: GPL-2.0

config MSM_CDC_PINCTRL
	tristate "CAF audio pin control"
	depends on SND_SOC && PINCTRL
	help
	  Switches the audio pin groups ("qcom,msm-cdc-pinctrl" nodes)
	  between their active and sleep states for the machine driver and
	  the headset helper. Without it the MI2S lines are never muxed.

config SND_SOC_MSM_WCD_MBHC
	tristate "WCD microphone bias and headset control"
	depends on SND_SOC
	select MSM_CDC_PINCTRL
	select SND_SOC_WCD_MBHC_ADC
	select SND_SOC_WCD_MBHC_LEGACY
	help
	  Microphone bias and headset detection helpers for the WCD family.

config SND_SOC_WCD_MBHC_LEGACY
	tristate

config SND_SOC_WCD_MBHC_ADC
	tristate "WCD microphone bias ADC variant"
	depends on SND_SOC
	help
	  Bias-voltage (ADC) based headset detection, one of the two
	  detection paths the MBHC helper selects between at runtime.

config WCD_DSP_GLINK
	tristate "WCD DSP glink manager"
	depends on SND_SOC
	help
	  Manager for the glink channel the WCD codecs use to reach the DSP.

config SND_SOC_SDM660_CDC
	tristate "SDM660/SDM450 CDC"
	depends on SND_SOC
	select SND_SOC_WCD_MBHC_ADC
	select SND_SOC_ANALOG_CDC
	select SND_SOC_DIGITAL_CDC_LEGACY
	help
	  The analog and digital CDC that this platform's own configuration
	  selects. The machine driver includes its headers directly, so it
	  is always needed alongside the soundcard.

config SND_SOC_ANALOG_CDC
	tristate
	select SND_SOC_MSM_WCD_MBHC

config SND_SOC_DIGITAL_CDC_LEGACY
	tristate

config SND_SOC_MSM8952
	tristate "MSM8952 (SDM450) soundcard"
	depends on SND_SOC && COMMON_CLK
	select MSM_CDC_PINCTRL
	select SND_SOC_SDM660_CDC
	help
	  Soundcard for this SoC, which CAF calls SDM450. It wires the
	  SDM660 CDC (the PMIC analog codec and the digital codec), the AFE
	  and the mi2s links.

#
# CAF's headers choose between the real implementation and a stub with
# these symbols. The port builds the real ones, so they have to be on:
# without them the header's stub and the source's definition are both
# in the same translation unit.
config DIGITAL_CDC_RSC_MGR
	bool "CAF digital CDC resource manager"

config DTS_SRS_TM
	bool "CAF SRS time machine parameter support"

config AFE_HWDEP
	bool "CAF AFE hardware calibration hwdep"

config SND_SOC_MSM_QDSP6V2_INTF
	bool "CAF audio event notification interface"

config XT_LOGGING
	bool "CAF AFE XT logging"

config MSM_MDF
	bool "CAF audio MDF topology support"
```
