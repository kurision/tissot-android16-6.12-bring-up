## Documentation/devicetree/bindings/clock/qcom,apcc-msm8953.yaml
```yaml
# SPDX-License-Identifier: (GPL-2.0 OR BSD-2-Clause)
%YAML 1.2
---
$id: http://devicetree.org/schemas/clock/qcom,apcc-msm8953.yaml#
$schema: http://devicetree.org/meta-schemas/core.yaml#

title: Qualcomm MSM8953 APCS CPU Clock Controller

maintainers:
  - Andy Gross <agross@kernel.org>

description: >
  The APCS block on MSM8953 contains the single APCS HF PLL that feeds both
  Cortex-A53 clusters and the system CCI, plus the three RCGCGR mux-dividers
  in front of them. All eight cores share one PLL and one voltage domain, so
  the PLL and mux-dividers are private to the controller. The three exported
  clock IDs report the rates of the two clusters and CCI. The two CPU clock
  IDs alias one shared domain clock. CPU rate changes are coupled across both
  clusters; CCI is read-only and follows the PLL at a fixed divide by 2.5.

  The block also owns the shared APC voltage rail. The regulator it drives is
  corner encoded rather than microvolt based, so the rail is programmed from
  a fused rate to corner plan read from this node, and the highest corner
  needed by the three outputs is applied before any frequency increase. The
  old voltage requirement is retained until all outputs have changed rate.
  The HF PLL logic additionally requires an active-only MX SVS level vote
  throughout the stock frequency range.

properties:
  compatible:
    const: qcom,apcc-msm8953

  reg:
    items:
      - description: APCS HF PLL register block
      - description: RCGCGR for CPU0 through CPU3
      - description: RCGCGR for CPU4 through CPU7
      - description: RCGCGR for the system CCI
      - description: PTE EFUSE, the fused speed bin lives in bits 8-10

  reg-names:
    items:
      - const: pll
      - const: cpu0-rcg-clk
      - const: cpu4-rcg-clk
      - const: cci-rcg-clk
      - const: pte-efuse

  clocks:
    items:
      - description: XO, the PLL reference and the bring-up source of the CPUs
      - description: GPLL0 early output, a boot time mux source
      - description: GPLL2 early output, a boot time mux source

  clock-names:
    items:
      - const: xo
      - const: gpll0_early
      - const: gpll2_early

  vdd-cl-supply:
    description:
      Regulator that supplies the shared APC rail. On this port it is the
      CPR4 APC regulator, whose values are corner numbers and not
      microvolts, with regulator-min-microvolt and regulator-max-microvolt
      spanning the corner range.

  power-domains:
    items:
      - description: Active-only MX domain supplying the HF PLL logic

  power-domain-names:
    items:
      - const: mx

  "#clock-cells":
    const: 1

patternProperties:
  "^qcom,speed[0-9]+-bin-v[0-9]+-(cl|cci)$":
    description: >
      Fused rate to corner plan for the CPU clusters (cl) or the CCI (cci),
      selected by the speed bin in the PTE EFUSE and the PVS version.
      The cells are rate in Hz and corner pairs in ascending rate order, so
      the cell count is even and the first pair is the idle one, rate 0
      corner 0. The driver falls back to the speed0 plan when no entry
      matches the fused bin.
    $ref: /schemas/types.yaml#/definitions/uint32-array

required:
  - compatible
  - reg
  - reg-names
  - clocks
  - clock-names
  - vdd-cl-supply
  - power-domains
  - power-domain-names
  - "#clock-cells"

additionalProperties: false

examples:
  - |
    #include <dt-bindings/clock/qcom,gcc-msm8953.h>
    #include <dt-bindings/power/qcom-rpmpd.h>

    xo: xo {
        #clock-cells = <0>;
    };

    gcc: clock-controller {
        compatible = "qcom,gcc-msm8953";
        #clock-cells = <1>;
    };

    apc_vreg: regulator {
        compatible = "regulator-fixed";
    };

    apcc: clock-controller@b116000 {
        compatible = "qcom,apcc-msm8953";
        reg = <0xb116000 0x50>,
              <0xb111050 0x10>,
              <0xb011050 0x10>,
              <0xb1d1050 0x10>,
              <0xa4124 0x8>;
        reg-names = "pll", "cpu0-rcg-clk", "cpu4-rcg-clk", "cci-rcg-clk",
                    "pte-efuse";
        clocks = <&xo>, <&gcc GPLL0_EARLY>, <&gcc GPLL2_EARLY>;
        clock-names = "xo", "gpll0_early", "gpll2_early";
        vdd-cl-supply = <&apc_vreg>;
        power-domains = <&rpmpd MSM8953_VDDMX_AO>;
        power-domain-names = "mx";
        qcom,speed0-bin-v0-cl = <0 0 652800000 1 1036800000 2
                                 1401600000 3 1689600000 4
                                 1804800000 5 1958400000 6
                                 2016000000 7>;
        qcom,speed0-bin-v0-cci = <0 0 261120000 1 414720000 2
                                  560640000 3 675840000 4
                                  721920000 5 783360000 6
                                  806400000 7>;
        #clock-cells = <1>;
    };
...
```

## Documentation/devicetree/bindings/regulator/qcom,cpr4-msm8953-apss-regulator.yaml
```yaml
# SPDX-License-Identifier: (GPL-2.0 OR BSD-2-Clause)
%YAML 1.2
---
$id: http://devicetree.org/schemas/regulator/qcom,cpr4-msm8953-apss-regulator.yaml#
$schema: http://devicetree.org/meta-schemas/core.yaml#

title: Qualcomm CPR4 APSS core regulator

maintainers:
  - Andy Gross <agross@kernel.org>

description: >
  Core Power Reduction version 4 for the application processor subsystem. The
  controller runs one ring-oscillator loop per thread and programs the shared
  APC supply that feeds both CPU clusters, in closed loop against the fused
  voltage ceiling and floor of each corner. It coordinates with the array power
  mux and the memory-ACC selector through phandles, and reads its own fuses.

  Each thread holds one regulator child whose exported values are corner
  numbers, not microvolts, so regulator-min-microvolt and
  regulator-max-microvolt span the corner range.

properties:
  compatible:
    const: qcom,cpr4-msm8953-apss-regulator

  reg:
    items:
      - description: CPR core register block
      - description: Qfuse block
    minItems: 2
    maxItems: 2

  reg-names:
    items:
      - const: cpr_ctrl
      - const: fuse_base

  interrupts:
    maxItems: 1

  interrupt-names:
    items:
      - const: cpr

  vdd-supply:
    description: Regulator that physically supplies the APC rail.

  vdd-limit-supply:
    description: Regulator exposing the hardware AVS limits of that rail.

  mem-acc-supply:
    description: Memory-ACC corner selector driven with the CPR corners.

  system-supply:
    description: Optional system regulator.

  qcom,apm-ctrl:
    $ref: /schemas/types.yaml#/definitions/phandle
    description: Array power mux this controller switches with.

  qcom,apm-threshold-voltage:
    $ref: /schemas/types.yaml#/definitions/uint32
    description: Voltage above which the array power mux moves to the MX supply.

  qcom,apm-hysteresis-voltage:
    $ref: /schemas/types.yaml#/definitions/uint32
    description: Hysteresis around the array power mux threshold.

  qcom,cpr-ctrl-name:
    $ref: /schemas/types.yaml#/definitions/string
    description: Name of this controller.

  qcom,cpr-enable:
    type: boolean
    description: Whether software closed-loop CPR may run at all.

  qcom,cpr-hw-closed-loop:
    type: boolean
    description: Whether the hardware closed-loop mode is used.

  qcom,cpr-sensor-time:
    $ref: /schemas/types.yaml#/definitions/uint32
    description: Ring oscillator sensor time, in unspecified units.

  qcom,cpr-loop-time:
    $ref: /schemas/types.yaml#/definitions/uint32
    description: Time between closed-loop iterations, in unspecified units.

  qcom,cpr-idle-cycles:
    $ref: /schemas/types.yaml#/definitions/uint32
    description: Idle iterations between closed-loop passes.

  qcom,cpr-count-mode:
    $ref: /schemas/types.yaml#/definitions/uint32
    description: Counting mode, all sensors at once or staggered.

  qcom,cpr-count-repeat:
    $ref: /schemas/types.yaml#/definitions/uint32
    description: How many times a counting pass is repeated.

  qcom,cpr-step-quot-init-min:
    $ref: /schemas/types.yaml#/definitions/uint32
    description: Minimum initial step quotient.

  qcom,cpr-step-quot-init-max:
    $ref: /schemas/types.yaml#/definitions/uint32
    description: Maximum initial step quotient.

  qcom,cpr-up-error-step-limit:
    $ref: /schemas/types.yaml#/definitions/uint32
    description: Upward step limit after an error.

  qcom,cpr-down-error-step-limit:
    $ref: /schemas/types.yaml#/definitions/uint32
    description: Downward step limit after an error.

  qcom,voltage-step:
    $ref: /schemas/types.yaml#/definitions/uint32
    description: Voltage step of one ring oscillator least significant bit.

  qcom,cpr-aging-ref-voltage:
    $ref: /schemas/types.yaml#/definitions/uint32
    description: Reference voltage used for aging.

  qcom,cpr-interrupt-affinity:
    $ref: /schemas/types.yaml#/definitions/phandle-list
    description: CPUs that may handle this controller's interrupt.

  qcom,cpr-panic-reg-addr-list:
    $ref: /schemas/types.yaml#/definitions/uint32-array
    description: Register addresses dumped when the CPR panic path triggers.

  qcom,cpr-panic-reg-name-list:
    $ref: /schemas/types.yaml#/definitions/string
    description: Names matching qcom,cpr-panic-reg-addr-list, in order.

patternProperties:
  "^thread(@[0-9]+)?$":
    type: object
    additionalProperties: false
    properties:
      qcom,cpr-thread-id:
        $ref: /schemas/types.yaml#/definitions/uint32
        description: Thread identifier, unique within the controller.

      qcom,cpr-consecutive-up:
        $ref: /schemas/types.yaml#/definitions/uint32
        description: Consecutive upward steps before the voltage is committed.

      qcom,cpr-consecutive-down:
        $ref: /schemas/types.yaml#/definitions/uint32
        description: Consecutive downward steps before the voltage is committed.

      qcom,cpr-up-threshold:
        $ref: /schemas/types.yaml#/definitions/uint32
        description: Headroom above the ceiling before stepping up.

      qcom,cpr-down-threshold:
        $ref: /schemas/types.yaml#/definitions/uint32
        description: Headroom below the floor before stepping down.

      "^(regulator|.*-regulator)$":
        allOf:
          - $ref: regulator.yaml#
        unevaluatedProperties: false
        properties:
          qcom,cpr-fuse-corners:
            $ref: /schemas/types.yaml#/definitions/uint32
            description: Number of fused voltage corners.

          qcom,cpr-fuse-combos:
            $ref: /schemas/types.yaml#/definitions/uint32
            description: Number of fused corner combinations.

          qcom,cpr-speed-bins:
            $ref: /schemas/types.yaml#/definitions/uint32
            description: Number of fused speed bins.

          qcom,cpr-speed-bin-corners:
            $ref: /schemas/types.yaml#/definitions/uint32-array
            description: Corner count per fused speed bin, in speed bin order.

          qcom,cpr-corners:
            $ref: /schemas/types.yaml#/definitions/uint32-array
            description: Corner count per speed bin, in speed bin order.

          qcom,cpr-corner-fmax-map:
            $ref: /schemas/types.yaml#/definitions/uint32-array
            description: >
              Highest usable corner per fused voltage corner, one row per
              speed bin.

          qcom,cpr-voltage-ceiling:
            $ref: /schemas/types.yaml#/definitions/uint32-array
            description: Ceiling voltage per corner, in microvolts.

          qcom,cpr-voltage-floor:
            $ref: /schemas/types.yaml#/definitions/uint32-array
            description: Floor voltage per corner, in microvolts.

          qcom,cpr-floor-to-ceiling-max-range:
            $ref: /schemas/types.yaml#/definitions/uint32-array
            description: Allowed floor to ceiling range per CPR revision.

          qcom,cpr-misc-fuse-voltage-adjustment:
            $ref: /schemas/types.yaml#/definitions/uint32-array
            description: Per corner adjustment from the miscellaneous fuses.

          qcom,mem-acc-voltage:
            $ref: /schemas/types.yaml#/definitions/uint32-array
            description: Memory-ACC corner selector per corner.

          qcom,corner-frequencies:
            $ref: /schemas/types.yaml#/definitions/uint32-array
            description: Frequency per corner, in hertz.

          qcom,cpr-open-loop-voltage-fuse-adjustment:
            $ref: /schemas/types.yaml#/definitions/uint32-array
            description: Open-loop adjustment per fused corner and revision.

          qcom,cpr-closed-loop-voltage-fuse-adjustment:
            $ref: /schemas/types.yaml#/definitions/uint32-array
            description: Closed-loop adjustment per fused corner and revision.

          qcom,cpr-ro-scaling-factor:
            $ref: /schemas/types.yaml#/definitions/uint32-array
            description: Ring oscillator scaling factor per fused corner.

          qcom,allow-voltage-interpolation:
            type: boolean
            description: Interpolate the open-loop voltage between corners.

          qcom,allow-quotient-interpolation:
            type: boolean
            description: Interpolate the target quotient between corners.

          qcom,cpr-scaled-open-loop-voltage-as-ceiling:
            type: boolean
            description: Treat the scaled open-loop voltage as the ceiling.

          qcom,cpr-aging-max-voltage-adjustment:
            $ref: /schemas/types.yaml#/definitions/uint32
            description: Maximum aging voltage adjustment.

          qcom,cpr-aging-ref-corner:
            $ref: /schemas/types.yaml#/definitions/uint32
            description: Corner the aging reference voltage belongs to.

          qcom,cpr-aging-ro-scaling-factor:
            $ref: /schemas/types.yaml#/definitions/uint32
            description: Ring oscillator scaling factor while aging.

          qcom,allow-aging-voltage-adjustment:
            $ref: /schemas/types.yaml#/definitions/uint32-array
            description: Per corner aging enable, in speed bin order.

    required:
      - qcom,cpr-thread-id
      - qcom,cpr-consecutive-up
      - qcom,cpr-consecutive-down
      - qcom,cpr-up-threshold
      - qcom,cpr-down-threshold

required:
  - compatible
  - reg
  - reg-names
  - interrupts
  - interrupt-names
  - vdd-supply
  - vdd-limit-supply
  - qcom,cpr-ctrl-name
  - qcom,voltage-step

examples:
  - |
    apc_cpr: cpr4-ctrl@b018000 {
        compatible = "qcom,cpr4-msm8953-apss-regulator";
        reg = <0xb018000 0x4000>, <0x00a4000 0x1000>;
        reg-names = "cpr_ctrl", "fuse_base";
        interrupts = <GIC_SPI 15 IRQ_TYPE_EDGE_RISING>;
        interrupt-names = "cpr";

        qcom,cpr-ctrl-name = "apc";
        qcom,cpr-sensor-time = <1000>;
        qcom,cpr-loop-time = <5000000>;
        qcom,cpr-idle-cycles = <15>;
        qcom,cpr-step-quot-init-min = <12>;
        qcom,cpr-step-quot-init-max = <14>;
        qcom,cpr-count-mode = <0>;
        qcom,cpr-count-repeat = <14>;
        qcom,cpr-down-error-step-limit = <1>;
        qcom,cpr-up-error-step-limit = <1>;
        qcom,voltage-step = <5000>;
        vdd-supply = <&pm8953_s5>;
        vdd-limit-supply = <&pm8953_s5_limit>;

        thread {
            qcom,cpr-thread-id = <0>;
            qcom,cpr-consecutive-up = <0>;
            qcom,cpr-consecutive-down = <2>;
            qcom,cpr-up-threshold = <2>;
            qcom,cpr-down-threshold = <1>;

            apc_vreg: regulator {
                regulator-name = "apc_corner";
                regulator-min-microvolt = <1>;
                regulator-max-microvolt = <9>;
                qcom,cpr-fuse-corners = <4>;
                qcom,cpr-corners = <7 7 7 7 7 7 7 7>;
                qcom,corner-frequencies = <652800000 1036800000
                    1401600000 1689600000 1804800000 1958400000 2016000000>;
            };
        };
    };
...
```
